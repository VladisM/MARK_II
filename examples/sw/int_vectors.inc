#ifndef INT_VECTORS
#define INT_VECTORS

.ORG 0x00000010 ;SYSTIM ISR
    RETI
.ORG 0x00000012
    RETI
.ORG 0x00000014
    RETI
.ORG 0x00000016
    RETI
.ORG 0x00000018
    RETI
.ORG 0x0000001A
    RETI
.ORG 0x0000001C
    RETI
.ORG 0x0000001E
    RETI
.ORG 0x00000020 ;UART0 tx ISR
    RETI
.ORG 0x00000022 ;UART0 rx ISR
    RETI
.ORG 0x00000024 ;UART1 tx ISR
    RETI
.ORG 0x00000026 ;UART1 rx ISR
    RETI
.ORG 0x00000028 ;UART2 tx ISR
    RETI
.ORG 0x0000002A ;UART2 rx ISR
    RETI
.ORG 0x0000002C ;TIM0 ISR
    RETI
.ORG 0x0000002E ;TIM1 ISR
    RETI
.ORG 0x00000030 ;TIM2 ISR
    RETI
.ORG 0x00000032 ;TIM3 ISR
    RETI
.ORG 0x00000034 ;KEYBOARD ISR
    RETI
.ORG 0x00000036
    RETI
.ORG 0x00000038
    RETI
.ORG 0x0000003A
    RETI
.ORG 0x0000003C
    RETI
.ORG 0x0000003E
    RETI
.ORG 0x00000040
    RETI
.ORG 0x00000042
    RETI
.ORG 0x00000044
    RETI
.ORG 0x00000046
    RETI
.ORG 0x00000048
    RETI
.ORG 0x0000004A
    RETI
.ORG 0x0000004C
    RETI
.ORG 0x0000004E
    RETI

#endif
