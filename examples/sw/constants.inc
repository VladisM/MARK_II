#ifndef CONSTANTS_INCLUDED
#define CONSTANTS_INCLUDED

;GPIO block
.CONS PORTA    0x000100
.CONS DDRA     0x000101
.CONS PORTB    0x000102
.CONS DDRB     0x000103

;SYSTIM
.CONS SYSTCR   0x000104
.CONS SYSTVR   0x000105

;INT
.CONS INTMR    0x000108

;UART0
.CONS UDR0     0x00010A
.CONS UCR0     0x00010B

;UART1
.CONS UDR1     0x00010C
.CONS UCR1     0x00010D

;UART2
.CONS UDR2     0x00010E
.CONS UCR2     0x00010F

;TIM0
.CONS TCCR0    0x000110
.CONS OCRA0    0x000111
.CONS OCRB0    0x000112
.CONS TCNR0    0x000113

;TIM1
.CONS TCCR1    0x000114
.CONS OCRA1    0x000115
.CONS OCRB1    0x000116
.CONS TCNR1    0x000117

;TIM2
.CONS TCCR2    0x000118
.CONS OCRA2    0x000119
.CONS OCRB2    0x00011A
.CONS TCNR2    0x00011B

;TIM3
.CONS TCCR3    0x00011C
.CONS OCRA3    0x00011D
.CONS OCRB3    0x00011E
.CONS TCNR3    0x00011F

;RAM
.CONS RAMSTART 0x000400
.CONS RAMEND   0x0007FF

;KEYBOARD
.CONS KEYBOARD 0x000109

#endif
